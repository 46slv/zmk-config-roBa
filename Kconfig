## Kconfig
```kconfig
# SPDX-License-Identifier: MIT

config ZMK_INPUT_PROCESSOR_ROBA_SCROLL
    bool "roBa unified axis-lock inertia scroll processor"
    default y
    depends on DT_HAS_ZMK_INPUT_PROCESSOR_ROBA_SCROLL_ENABLED
    select ZMK_POINTING
    help
      Enable roBa's combined axis-selection and inertial-scroll processor.
      The processor keeps initial gesture deltas while selecting an axis and
      uses the same state and scale for active and coasting output.
```

## config/west.yml
```yaml
manifest:
  remotes:
    - name: zmkfirmware
      url-base: https://github.com/zmkfirmware
    - name: caksoylar
      url-base: https://github.com/caksoylar
    - name: 4mplelab
      url-base: https://github.com/4mplelab
    - name: kot149
      url-base: https://github.com/kot149
    - name: kumamuk-git
      url-base: https://github.com/kumamuk-git
    - name: 46slv
      url-base: https://github.com/46slv
    - name: ssbb
      url-base: https://github.com/ssbb
    - name: oleksandrmaslov
      url-base: https://github.com/oleksandrmaslov
      
  projects:
    # https://github.com/zmkfirmware/zmk
    - name: zmk
      remote: zmkfirmware
      revision: v0.3
      import: app/west.yml

    # https://github.com/kumamuk-git/zmk-pmw3610-driver
    - name: zmk-pmw3610-driver
      remote: kumamuk-git
      revision: main

    - name: zmk-listeners
      remote: ssbb
      revision: v1
      path: modules/zmk-listeners

    # https://github.com/caksoylar/zmk-rgbled-widget
    - name: zmk-rgbled-widget
      remote: caksoylar
      revision: v0.3-branch
      path: modules/zmk-rgbled-widget

    # https://github.com/4mplelab/zmk-feature-charge-indicator
    - name: zmk-feature-charge-indicator
      remote: 4mplelab
      revision: main
      path: modules/zmk-feature-charge-indicator

    - name: zmk-mouse-gesture
      remote: kot149
      revision: v1
      path: modules/zmk-mouse-gesture

    # https://github.com/kot149/zmk-layout-shift
    - name: zmk-layout-shift
      remote: kot149
      revision: v1
      path: modules/zmk-layout-shift

    - name: zmk-pointing-acceleration
      remote: oleksandrmaslov
      revision: main
      path: modules/zmk-pointing-acceleration

    # https://github.com/46slv/zmk-input-processor-roba-scroll
    - name: zmk-input-processor-roba-scroll
      remote: 46slv
      revision: 0c7a8fe243d1182c090a138005d275795d7b206b
      path: modules/zmk-input-processor-roba-scroll

  self:
    path: config
```

## dts/bindings/behaviors/zmk,behavior-roba-encoder-scroll.yaml
```yaml
# Copyright (c) 2026 roBa contributors
# SPDX-License-Identifier: MIT

description: roBa velocity-sensitive one-shot encoder scroll behavior

compatible: "zmk,behavior-roba-encoder-scroll"

properties:
  label:
    type: string
    required: false
    deprecated: true

  "#sensor-binding-cells":
    type: int
    required: true
    const: 0

  base-delta:
    type: int
    default: 1
    description: Finite vertical wheel units emitted at 1x

  two-x-ms:
    type: int
    default: 180
    description: Inter-detent interval below which 2x is requested

  four-x-ms:
    type: int
    default: 100
    description: Inter-detent interval below which 4x is requested

  six-x-ms:
    type: int
    default: 55
    description: Inter-detent interval below which 6x is requested

  reset-ms:
    type: int
    default: 280
    description: Idle interval that resets acceleration to 1x

  fast-streak:
    type: int
    default: 2
    description: Consecutive fast intervals held at each 2x and 4x ramp stage

  inertia-streak:
    type: int
    default: 3
    description: Consecutive 6x outputs required to arm the coast tail

  stop-ms:
    type: int
    default: 80
    description: No-input interval after an armed gesture before coast starts

  coast-tick-ms:
    type: int
    default: 24
    description: Delay between finite coast reports

  coast-start-multiplier:
    type: int
    default: 4
    description: Multiplier used by the first coast report

  coast-ticks:
    type: int
    default: 4
    description: Maximum number of coast reports

  inertia-enabled:
    type: boolean
    description: Enable the maximum-tier-only finite coast tail
```

## dts/bindings/zmk,input-processor-roba-scroll.yaml
```yaml
description: |
  Unified axis-selection and inertial-scroll processor for roBa. Place it
  directly after zip_xy_to_scroll_mapper. It retains initial movement while
  selecting an axis, scales active events with per-axis remainders, tracks
  velocity, and emits direct-HID coast from the same scale setting.

compatible: "zmk,input-processor-roba-scroll"

properties:
  "#input-processor-cells":
    type: int
    required: true
    const: 0

  axis-mode:
    type: int
    default: 0
    enum: [0, 1]
    description: "0 = automatic X/Y snap, 1 = free two-axis scrolling."
  snap-x-ratio:
    type: array
    required: true
    description: "X selection ratio numerator and denominator."
  snap-y-ratio:
    type: array
    required: true
    description: "Y selection ratio numerator and denominator."
  snap-events:
    type: int
    default: 2
    description: "Events retained before initial axis selection."
  snap-immediate:
    type: int
    default: 200
    description: "Pending absolute movement that selects immediately."
  snap-lock-ms:
    type: int
    default: 175
    description: "Time guard before a continuous cross-axis switch."
  snap-lock-events:
    type: int
    default: 8
    description: "Event guard before a continuous cross-axis switch."
  snap-idle-ms:
    type: int
    default: 175
    description: "Silence that resets axis sampling and lock state."
  snap-switch:
    type: int
    default: 1
    description: "Retained cross-axis movement required after lock expiry."
  invert-x:
    type: boolean
    description: "Invert horizontal wheel input before axis selection."
  invert-y:
    type: boolean
    description: "Invert vertical wheel input before axis selection."

  gain:
    type: int
    default: 300
    description: "EMA input weight in permille."
  blend:
    type: int
    default: 700
    description: "EMA history weight in permille; gain + blend should be 1000."
  start:
    type: int
    default: 40
    description: "Minimum peak velocity for inertia arming."
  move:
    type: int
    default: 80
    description: "Minimum cumulative movement for inertia arming."
  release:
    type: int
    default: 24
    description: "No-input milliseconds before release is detected."
  min-events:
    type: int
    default: 10
    description: "Minimum tracked events before inertia can arm."
  decel-samples:
    type: int
    default: 3
    description: "Sub-peak samples required to confirm deceleration."
  decel-ratio:
    type: int
    default: 850
    description: "Deceleration threshold relative to peak, in permille."
  peak-decay:
    type: int
    default: 990
    description: "Peak velocity decay per event, in permille."
  gesture-timeout:
    type: int
    default: 100
    description: "Silence that resets inertia tracking state."
  suppress-limit:
    type: int
    default: 50
    description: "Safety limit for absorbed same-direction coast events."
  handoff-ms:
    type: int
    default: 100
    description: "Initial coast handoff window in milliseconds."

  fast:
    type: int
    default: 0
    description: "Fast decay-zone velocity boundary; 0 disables the zone."
  decay-fast:
    type: int
    default: 990
    description: "Fast-zone multiplicative decay in permille per tick."
  decay-slow:
    type: int
    default: 990
    description: "Middle-zone multiplicative decay in permille per tick."
  slow:
    type: int
    default: 0
    description: "Tail decay-zone velocity boundary; 0 disables the zone."
  decay-tail:
    type: int
    default: 990
    description: "Tail-zone multiplicative decay in permille per tick."
  friction:
    type: int
    default: 35
    description: "Additive deceleration in permille of a scroll unit per tick."
  stop:
    type: int
    default: 7
    description: "Velocity below which coast stops."
  limit:
    type: int
    default: 600
    description: "Maximum tracked velocity."
  span:
    type: int
    default: 6000
    description: "Maximum coast duration in milliseconds."
  tick:
    type: int
    default: 8
    description: "Coast update interval in milliseconds."

  scale:
    type: int
    default: 1000
    description: "Shared active and coast output-scale numerator."
  scale-div:
    type: int
    default: 1000
    description: "Shared active and coast output-scale denominator."
  axis:
    type: int
    default: 0
    enum: [0, 1, 2]
    description: "Inertia axes: 0 = both, 1 = Y, 2 = X. Use 0 with snap mode."
  layer:
    type: int
    default: -1
    description: "Layer whose deactivation resets all processor state."
  swap-mod:
    type: int
    default: 0
    description: "Modifier mask that swaps single-axis output."
  unlock-mod:
    type: int
    default: 0
    description: "Modifier mask that temporarily uses free two-axis inertia."
  exact-magnitude:
    type: boolean
    description: "Use integer sqrt instead of the fast vector approximation."
  track-remainders:
    type: boolean
    description: "Unused; the processor owns active and coast remainders."
```

## zephyr/Kconfig
```kconfig
menu "roBa features"

config ROBA_ENCODER_SCROLL
    bool "roBa velocity-sensitive one-shot encoder scroll"
    default y
    depends on DT_HAS_ZMK_BEHAVIOR_ROBA_ENCODER_SCROLL_ENABLED
    select ZMK_POINTING
    help
      Replaces queued mouse-scroll press/release taps with finite wheel
      reports. Slow detents remain precise, fast consecutive detents use
      bounded acceleration, and an optional maximum-tier-only coast tail
      always terminates after a fixed report count.

config ROBA_STATUS
    bool "roBa read-only status service"
    depends on ZMK_BLE && ZMK_SPLIT_ROLE_CENTRAL
    default y if SHIELD_ROBA_R
    help
      Exposes the active ZMK layer state through a read-only encrypted BLE
      GATT characteristic for the companion Windows status application.
      No keycodes or typed content are transmitted.

config ROBA_STATUS_USB
    bool "roBa read-only USB HID status transport"
    depends on ROBA_STATUS && ZMK_USB
    default y
    help
      Adds a second vendor-defined HID interface that reports the same status
      packet over USB. It remains separate from keyboard/mouse HID and the ZMK
      Studio CDC transport.

endmenu
```
